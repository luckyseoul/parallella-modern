## buildroot/configs/parallella_defconfig
```kconfig
# Parallella 16 - Modern Buildroot Configuration
BR2_arm=y
BR2_cortex_a9=y

# Toolchain
BR2_TOOLCHAIN_EXTERNAL=y

# Kernel
BR2_LINUX_KERNEL=y
BR2_LINUX_KERNEL_DEFCONFIG="xilinx_zynq"

# System
BR2_SYSTEM_DHCP="eth0"
BR2_TARGET_GENERIC_HOSTNAME="parallella"

# Packages
BR2_PACKAGE_PYTHON3=y
BR2_PACKAGE_DIALOG=y
BR2_PACKAGE_WPA_SUPPLICANT=y
BR2_PACKAGE_SYSTEMD=y
BR2_PACKAGE_SYSTEMD_RESOLVED=y

# Epiphany
BR2_PACKAGE_HOST_EPHANY_SDK=y

# Desktop (optional)
BR2_PACKAGE_XFCE4_SESSION=y
BR2_PACKAGE_XORG=y
```

## buildroot/configs/parallella_desktop_defconfig
```kconfig
# Parallella 16 - Desktop (XFCE) Image
BR2_arm=y
BR2_cortex_a9=y

BR2_TOOLCHAIN_EXTERNAL=y

BR2_LINUX_KERNEL=y
BR2_LINUX_KERNEL_DEFCONFIG="xilinx_zynq"

BR2_SYSTEM_DHCP="eth0"
BR2_TARGET_GENERIC_HOSTNAME="parallella"

BR2_PACKAGE_PYTHON3=y
BR2_PACKAGE_DIALOG=y
BR2_PACKAGE_WPA_SUPPLICANT=y
BR2_PACKAGE_SYSTEMD=y

# Epiphany SDK
BR2_PACKAGE_HOST_EPHANY_SDK=y

# Desktop Environment
BR2_PACKAGE_XORG=y
BR2_PACKAGE_XFCE4_SESSION=y
BR2_PACKAGE_XFCE4_TERMINAL=y
BR2_PACKAGE_LIGHTDM=y

# Useful desktop packages
BR2_PACKAGE_FIREFOX=y
BR2_PACKAGE_HTOP=y
BR2_PACKAGE_GIT=y
```

## external/parallella/package/etop/Config.in
```kconfig
config BR2_PACKAGE_ETOP
	bool "etop"
	help
	  Lightweight Epiphany mesh monitor.
```
